## conf/layer.conf
```bitbake
# We have a conf and classes directory, add to BBPATH
BBPATH .= ":${LAYERDIR}"

# We have recipes-* directories, add to BBFILES
BBFILES += "${LAYERDIR}/recipes-*/*/*.bb \
            ${LAYERDIR}/recipes-*/*/*.bbappend"

BBFILE_COLLECTIONS += "gt-bsp"
BBFILE_PATTERN_gt-bsp := "^${LAYERDIR}/"
BBFILE_PRIORITY_gt-bsp = "6"
```
